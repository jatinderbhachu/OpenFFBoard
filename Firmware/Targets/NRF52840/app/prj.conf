## CMakeLists.txt
```
cmake_minimum_required(VERSION 3.20.0)

set(BOARD promicro_nrf52840/nrf52840/uf2)

find_package(Zephyr REQUIRED HINTS $ENV{ZEPHYR_BASE})

project(openffboard)


file(GLOB FFBOARD_SRC_FILES ../../../FFBoard/Src/*)
file(GLOB FFBOARD_USR_EXT_SRC_FILES ../../../FFBoard/UserExtensions/Src/*)


file(GLOB FFBOARD_TINYUSB_SRC_FILES 
    ../../../FFBoard/USB/*.c
    ../../../FFBoard/USB/class/audio/*.c
    ../../../FFBoard/USB/class/bth/*.c
    ../../../FFBoard/USB/class/cdc/*.c
    ../../../FFBoard/USB/class/dfu/*.c
    ../../../FFBoard/USB/class/hid/*.c
    ../../../FFBoard/USB/class/midi/*.c
    ../../../FFBoard/USB/class/msc/*.c
    ../../../FFBoard/USB/class/net/*.c
    ../../../FFBoard/USB/class/usbtmc/*.c
    ../../../FFBoard/USB/class/vendor/*.c
    ../../../FFBoard/USB/common/*.c
    ../../../FFBoard/USB/device/*.c
    ../../../FFBoard/USB/host/*.c
    ../../../FFBoard/USB/portable/nordic/nrf5x/*.c
)

list(FILTER FFBOARD_SRC_FILES EXCLUDE REGEX ".*cthread\\.cpp$")
list(FILTER FFBOARD_SRC_FILES EXCLUDE REGEX ".*cppmain\\.cpp$")
list(FILTER FFBOARD_SRC_FILES EXCLUDE REGEX ".*eeprom\\.c$")

target_include_directories(
    app
    PRIVATE
    src/
    src/stm32_hal/
    ../../../FFBoard/Inc
    ../../../FFBoard/UserExtensions/Inc
    ../../../FFBoard/USB
    ../../../FFBoard/USB/device
    ../../../FFBoard/USB/portable/synopsys/dwc2/
    ../../../FFBoard/USB/class/cdc
    ../../../FFBoard/USB/class/midi
    ../../../FFBoard/USB/class/hid

    src/dummy_includes
    src/freertos_wrappers
)

target_sources(
    app 
    PRIVATE

    src/main.c
    src/cppmain.cpp
    src/wrapper.cpp
    src/eeprom.cpp
    src/freertos_wrappers/thread.cpp
    src/freertos_wrappers/mutex.cpp
    src/freertos_wrappers/semaphore.cpp
    ${FFBOARD_SRC_FILES}
    ${FFBOARD_USR_EXT_SRC_FILES}
    ${FFBOARD_TINYUSB_SRC_FILES}
)

# target_compile_options(${COMPONENT_LIB} PRIVATE -std=gnu++20 -fexceptions -Wno-ignored-qualifiers -Wno-deprecated-declarations -Wno-missing-field-initializers -Wno-nonnull)
```

## prj.conf
```kconfig
CONFIG_CPP=y
CONFIG_STD_CPP20=y
CONFIG_REQUIRES_FULL_LIBCPP=y
CONFIG_CPP_EXCEPTIONS=n
CONFIG_CPP_RTTI=n
CONFIG_LOG=y
CONFIG_HEAP_MEM_POOL_SIZE=65536
CONFIG_COMMON_LIBC_MALLOC_ARENA_SIZE=32768
CONFIG_UART_CONSOLE=n
CONFIG_RTT_CONSOLE=y
CONFIG_USE_SEGGER_RTT=y
CONFIG_LOG_BACKEND_RTT_BUFFER_SIZE=4096
CONFIG_LOG_BACKEND_RTT_OUTPUT_BUFFER_SIZE=128
CONFIG_LOG_PROCESS_THREAD=y
CONFIG_UART_INTERRUPT_DRIVEN=y
CONFIG_FPU=y
CONFIG_GPIO=y
CONFIG_NEWLIB_LIBC=n
CONFIG_PICOLIBC=y
CONFIG_STDOUT_CONSOLE=n
CONFIG_THREAD_CUSTOM_DATA=y
# CONFIG_UDC_NRF=y
# CONFIG_UDC_DRIVER=y
# CONFIG_NRF_USBD_COMMON=y
# CONFIG_USB_DEVICE_DRIVER=y

CONFIG_FLASH=y
CONFIG_NVS=y

CONFIG_USB_DEVICE_STACK=n

# CONFIG_CLOCK_CONTROL_NRF_K32SRC_RC=y
# CONFIG_CLOCK_CONTROL_NRF_K32SRC_SYNTH=y




CONFIG_LOG_BACKEND_RTT_BUFFER=1
# CONFIG_PRINTK=n
CONFIG_LOG_PRINTK=n
CONFIG_USERSPACE=y
CONFIG_DYNAMIC_OBJECTS=y

CONFIG_THREAD_NAME=y
CONFIG_LOG_PROCESS_THREAD=y

CONFIG_ASSERT=n
CONFIG_ASSERT_LEVEL=0
CONFIG_DEBUG_COREDUMP=n
CONFIG_DEBUG_COREDUMP_BACKEND_LOGGING=n
CONFIG_DEBUG=n
CONFIG_DEBUG_INFO=n
CONFIG_THREAD_ANALYZER=n

# CONFIG_DEBUG=y
# CONFIG_DEBUG_INFO=y
# CONFIG_THREAD_ANALYZER=y
# CONFIG_DEBUG_COREDUMP=y
# CONFIG_DEBUG_COREDUMP_BACKEND_LOGGING=y
# CONFIG_DEBUG_COREDUMP_THREADS_METADATA=y
# CONFIG_ASSERT=y
# CONFIG_ASSERT_LEVEL=2
# CONFIG_THREAD_ANALYZER_AUTO=y
# CONFIG_THREAD_ANALYZER_AUTO_INTERVAL=5
# CONFIG_MPU_STACK_GUARD=y
# CONFIG_NULL_POINTER_EXCEPTION_DETECTION_MPU=y

CONFIG_NUM_PREEMPT_PRIORITIES=57
# CONFIG_NUM_COOP_PRIORITIES=10

CONFIG_SPEED_OPTIMIZATIONS=y
CONFIG_DEBUG_OPTIMIZATIONS=n

CONFIG_CLOCK_CONTROL=y

# CONFIG_SPEED_OPTIMIZATIONS=n
# CONFIG_DEBUG_OPTIMIZATIONS=y


CONFIG_HW_STACK_PROTECTION=n
CONFIG_MAIN_STACK_SIZE=8192
CONFIG_INIT_STACKS=y
CONFIG_THREAD_STACK_INFO=y
CONFIG_MAX_THREAD_BYTES=6
CONFIG_DYNAMIC_THREAD_POOL_SIZE=32
CONFIG_DEBUG_THREAD_INFO=y
CONFIG_DYNAMIC_THREAD=y
CONFIG_DYNAMIC_THREAD_ALLOC=y
# CONFIG_DYNAMIC_THREAD_PREFER_ALLOC=y
CONFIG_DYNAMIC_THREAD_PREFER_POOL=y
CONFIG_SYSTEM_WORKQUEUE_STACK_SIZE=4096
# CONFIG_POSIX_API=y
CONFIG_ESB=y
CONFIG_NRFX_POWER=y
```

## src/main.c
```c
#include <stdlib.h>


extern void cppmain();

void main(void) {
  cppmain();
}
```

## src/FreeRTOSConfig.h
```c
/* USER CODE BEGIN Header */
/*
 * FreeRTOS Kernel V10.2.1
 * Portion Copyright (C) 2017 Amazon.com, Inc. or its affiliates.  All Rights Reserved.
 * Portion Copyright (C) 2019 StMicroelectronics, Inc.  All Rights Reserved.
 *
 * Permission is hereby granted, free of charge, to any person obtaining a copy of
 * this software and associated documentation files (the "Software"), to deal in
 * the Software without restriction, including without limitation the rights to
 * use, copy, modify, merge, publish, distribute, sublicense, and/or sell copies of
 * the Software, and to permit persons to whom the Software is furnished to do so,
 * subject to the following conditions:
 *
 * The above copyright notice and this permission notice shall be included in all
 * copies or substantial portions of the Software.
 *
 * THE SOFTWARE IS PROVIDED "AS IS", WITHOUT WARRANTY OF ANY KIND, EXPRESS OR
 * IMPLIED, INCLUDING BUT NOT LIMITED TO THE WARRANTIES OF MERCHANTABILITY, FITNESS
 * FOR A PARTICULAR PURPOSE AND NONINFRINGEMENT. IN NO EVENT SHALL THE AUTHORS OR
 * COPYRIGHT HOLDERS BE LIABLE FOR ANY CLAIM, DAMAGES OR OTHER LIABILITY, WHETHER
 * IN AN ACTION OF CONTRACT, TORT OR OTHERWISE, ARISING FROM, OUT OF OR IN
 * CONNECTION WITH THE SOFTWARE OR THE USE OR OTHER DEALINGS IN THE SOFTWARE.
 *
 * http://www.FreeRTOS.org
 * http://aws.amazon.com/freertos
 *
 * 1 tab == 4 spaces!
 */
/* USER CODE END Header */

#ifndef FREERTOS_CONFIG_H
#define FREERTOS_CONFIG_H

/*-----------------------------------------------------------
 * Application specific definitions.
 *
 * These definitions should be adjusted for your particular hardware and
 * application requirements.
 *
 * These parameters and more are described within the 'configuration' section of the
 * FreeRTOS API documentation available on the FreeRTOS.org web site.
 *
 * See http://www.freertos.org/a00110.html
 *----------------------------------------------------------*/

/* USER CODE BEGIN Includes */
/* Section where include file can be added */
/* USER CODE END Includes */

/* Ensure definitions are only used by the compiler, and not by the assembler. */
#if defined(__ICCARM__) || defined(__CC_ARM) || defined(__GNUC__)
  #include <stdint.h>
  extern uint32_t SystemCoreClock;
#endif
#ifndef CMSIS_device_header
#define CMSIS_device_header "stm32f4xx.h"
#endif /* CMSIS_device_header */

#define configENABLE_FPU                         1
#define configENABLE_MPU                         0

#define configUSE_PREEMPTION                     1
#define configSUPPORT_STATIC_ALLOCATION          1
#define configSUPPORT_DYNAMIC_ALLOCATION         1
#define configUSE_IDLE_HOOK                      1
#define configUSE_TICK_HOOK                      0
#define configCPU_CLOCK_HZ                       ( SystemCoreClock )
#define configTICK_RATE_HZ                       ((TickType_t)1000)
#define configMAX_PRIORITIES                     ( 56 )
#define configMINIMAL_STACK_SIZE                 ((uint16_t)64)
#define configTOTAL_HEAP_SIZE                    ((size_t)0xffff)
#define configMAX_TASK_NAME_LEN                  ( 16 )
#define configUSE_TRACE_FACILITY                 1
#define configUSE_16_BIT_TICKS                   0
#define configUSE_MUTEXES                        1
#define configQUEUE_REGISTRY_SIZE                8
#define configCHECK_FOR_STACK_OVERFLOW           2
#define configUSE_RECURSIVE_MUTEXES              1
#define configUSE_MALLOC_FAILED_HOOK             1
#define configUSE_COUNTING_SEMAPHORES            1
#define configUSE_PORT_OPTIMISED_TASK_SELECTION  0
#define configRECORD_STACK_HIGH_ADDRESS          1
/* USER CODE BEGIN MESSAGE_BUFFER_LENGTH_TYPE */
/* Defaults to size_t for backward compatibility, but can be changed
   if lengths will always be less than the number of bytes in a size_t. */
#define configMESSAGE_BUFFER_LENGTH_TYPE         size_t
/* USER CODE END MESSAGE_BUFFER_LENGTH_TYPE */

/* Co-routine definitions. */
#define configUSE_CO_ROUTINES                    0
#define configMAX_CO_ROUTINE_PRIORITIES          ( 2 )

/* Software timer definitions. */
#define configUSE_TIMERS                         1
#define configTIMER_TASK_PRIORITY                ( 2 )
#define configTIMER_QUEUE_LENGTH                 10
#define configTIMER_TASK_STACK_DEPTH             128

/* The following flag must be enabled only when using newlib */
#define configUSE_NEWLIB_REENTRANT          1

/* CMSIS-RTOS V2 flags */
#define configUSE_OS2_THREAD_SUSPEND_RESUME  1
#define configUSE_OS2_THREAD_ENUMERATE       1
#define configUSE_OS2_EVENTFLAGS_FROM_ISR    1
#define configUSE_OS2_THREAD_FLAGS           1
#define configUSE_OS2_TIMER                  1
#define configUSE_OS2_MUTEX                  1

/* Set the following definitions to 1 to include the API function, or zero
to exclude the API function. */
#define INCLUDE_vTaskPrioritySet             1
#define INCLUDE_uxTaskPriorityGet            1
#define INCLUDE_vTaskDelete                  1
#define INCLUDE_vTaskCleanUpResources        0
#define INCLUDE_vTaskSuspend                 1
#define INCLUDE_vTaskDelayUntil              1
#define INCLUDE_vTaskDelay                   1
#define INCLUDE_xTaskGetSchedulerState       1
#define INCLUDE_xTimerPendFunctionCall       1
#define INCLUDE_xQueueGetMutexHolder         1
#define INCLUDE_uxTaskGetStackHighWaterMark  1
#define INCLUDE_xTaskGetCurrentTaskHandle    1
#define INCLUDE_eTaskGetState                1

/*
 * The CMSIS-RTOS V2 FreeRTOS wrapper is dependent on the heap implementation used
 * by the application thus the correct define need to be enabled below
 */
#define USE_FreeRTOS_HEAP_4

/* Cortex-M specific definitions. */
// #ifdef __NVIC_PRIO_BITS
//  /* __BVIC_PRIO_BITS will be specified when CMSIS is being used. */
//  #define configPRIO_BITS         __NVIC_PRIO_BITS
// #else
//  #define configPRIO_BITS         4
// #endif

/* The lowest interrupt priority that can be used in a call to a "set priority"
function. */
#define configLIBRARY_LOWEST_INTERRUPT_PRIORITY   15

/* The highest interrupt priority that can be used by any interrupt service
routine that makes calls to interrupt safe FreeRTOS API functions.  DO NOT CALL
INTERRUPT SAFE FREERTOS API FUNCTIONS FROM ANY INTERRUPT THAT HAS A HIGHER
PRIORITY THAN THIS! (higher priorities are lower numeric values. */
#define configLIBRARY_MAX_SYSCALL_INTERRUPT_PRIORITY 5

/* Interrupt priorities used by the kernel port layer itself.  These are generic
to all Cortex-M ports, and do not rely on any particular library functions. */
#define configKERNEL_INTERRUPT_PRIORITY 		( configLIBRARY_LOWEST_INTERRUPT_PRIORITY << (8 - configPRIO_BITS) )
/* !!!! configMAX_SYSCALL_INTERRUPT_PRIORITY must not be set to zero !!!!
See http://www.FreeRTOS.org/RTOS-Cortex-M3-M4.html. */
#define configMAX_SYSCALL_INTERRUPT_PRIORITY 	( configLIBRARY_MAX_SYSCALL_INTERRUPT_PRIORITY << (8 - configPRIO_BITS) )

/* Normal assert() semantics without relying on the provision of an assert.h
header file. */
/* USER CODE BEGIN 1 */
#define configASSERT( x ) if ((x) == 0) {taskDISABLE_INTERRUPTS(); for( ;; );}
/* USER CODE END 1 */

/* Definitions that map the FreeRTOS port interrupt handlers to their CMSIS
standard names. */
#define vPortSVCHandler    SVC_Handler
#define xPortPendSVHandler PendSV_Handler

/* IMPORTANT: After 10.3.1 update, Systick_Handler comes from NVIC (if SYS timebase = systick), otherwise from cmsis_os2.c */

#define USE_CUSTOM_SYSTICK_HANDLER_IMPLEMENTATION 0

/* USER CODE BEGIN Defines */
#define CPP_FREERTOS_NO_EXCEPTIONS // For freertos cpp addons
#define configAPPLICATION_ALLOCATED_HEAP 1 // ucHeap allocated in freertos.c
#define CPP_FREERTOS_CONDITION_VARIABLES

/* Section where parameter definitions can be added (for instance, to override default ones in FreeRTOS.h) */
/* USER CODE END Defines */

#endif /* FREERTOS_CONFIG_H */
```

## src/cppmain.cpp
```c
#include "cppmain.h"
#include "cpp_target_config.h"
#include "flash_helpers.h"
#include "global_callbacks.h"
#include "mainclass_chooser.h"
// #include "cmsis_os.h"
#include "tusb.h"

#include <zephyr/drivers/gpio.h>

#include "nrfx.h"
#include <zephyr/dt-bindings/regulator/nrf5x.h>

#include <hal/nrf_usbd.h>
#include <nrfx_clock.h>
#include <nrfx_power.h>
#include <tusb.h>

uint32_t clkmhz = HAL_RCC_GetHCLKFreq() / 100000;

#ifdef HAL_IWDG_MODULE_ENABLED
extern IWDG_HandleTypeDef hiwdg; // Watchdog
#endif

bool running = true;
bool mainclassChosen = false;

uint16_t main_id = 0;

FFBoardMain *mainclass __attribute__((section(CCRAM_SEC)));
ClassChooser<FFBoardMain> mainchooser(class_registry);

#define USBD_STACK_SIZE (3 * configMINIMAL_STACK_SIZE / 2)
StackType_t usb_device_stack[USBD_STACK_SIZE];
StaticTask_t usb_device_taskdef;

extern "C" void tusb_hal_nrf_power_event(uint32_t event);

static void power_event_handler(nrfx_power_usb_evt_t event) {
  tusb_hal_nrf_power_event((uint32_t)event);
}

void USBD_IRQHandler(void) { tud_int_handler(0); }

enum {
  USB_EVT_DETECTED = 0,
  USB_EVT_REMOVED = 1,
  USB_EVT_READY = 2,
};

void init_usb() {
#define DT_DRV_COMPAT nordic_nrf_usbd
  IRQ_CONNECT(DT_INST_IRQN(0), DT_INST_IRQ(0, priority), nrfx_isr,
              USBD_IRQHandler, 0);
  // IRQ_CONNECT(DT_INST_IRQN(0), 2, nrfx_isr, USBD_IRQHandler, 0);
  irq_enable(DT_INST_IRQN(0));

  uint32_t usb_reg;
  usb_reg = NRF_POWER->USBREGSTATUS;

  {
    // Power module init
    const nrfx_power_config_t pwr_cfg = {0};
    nrfx_power_init(&pwr_cfg);

    // Register tusb function as USB power handler
    // cause cast-function-type warning
    const nrfx_power_usbevt_config_t config = {.handler = power_event_handler};
    nrfx_power_usbevt_init(&config);
    nrfx_power_usbevt_enable();
    usb_reg = NRF_POWER->USBREGSTATUS;
  }

  if (usb_reg & POWER_USBREGSTATUS_VBUSDETECT_Msk) {
    tusb_hal_nrf_power_event(USB_EVT_DETECTED);
  }
  if (usb_reg & POWER_USBREGSTATUS_OUTPUTRDY_Msk) {
    tusb_hal_nrf_power_event(USB_EVT_READY);
  }
}

void cppmain() {
  printf("cppmain\n");

  init_usb();

#ifdef FW_DEVID
  if (HAL_GetDEVID() != FW_DEVID) {
    /**
     * Firmware is not intended for this chip!
     * This can be caused by accidentially flashing an incorrect firmware file
     * and likely screws up clock and pin configs Do not proceed.
     */
    while (true) { // Block forever to prevent an incorrect firmware from
                   // damaging hardware
      Error_Handler();
    }
  }
#endif

  // Flash init
  if (!Flash_Init()) {
    Error_Handler();
  }

  // Check if flash is initialized
  uint16_t lastFlashVersion = 0;
  if (!Flash_Read(ADR_FLASH_VERSION,
                  &lastFlashVersion)) { // Version never written
    Flash_Write(ADR_FLASH_VERSION, FLASH_VERSION);
  }
  Flash_Read(ADR_FLASH_VERSION, &lastFlashVersion);
  if (lastFlashVersion != FLASH_VERSION) {
    Flash_Format(); // Major version changed or could not write initial value.
                    // force a format
    Flash_Write(ADR_FLASH_VERSION, FLASH_VERSION);
  }

  // ------------------------

  // startADC(); // enable ADC DMA

  // If switch pressed at boot select failsafe implementation
  // #ifdef BTNFAILSAFE
  // 	if(HAL_GPIO_ReadPin(BUTTON_A_GPIO_Port, BUTTON_A_Pin) == 1){
  // 		main_id = 0;
  // 	}else
  // #endif
  if (!Flash_ReadWriteDefault(ADR_CURRENT_CONFIG, &main_id, DEFAULTMAIN)) {
    Error_Handler();
  }

  PersistentStorage::restoreFlashStartupCb(); // Flash is initialized. allow
                                              // restoring now

  mainclass = mainchooser.Create(main_id);
  if (mainclass == nullptr) {          // invalid id
    mainclass = mainchooser.Create(0); // Baseclass
  }
  mainclassChosen = true;

  mainclass->usbInit(); // Let mainclass initialize usb

  while (running) {
    mainclass->update();
    k_sleep(K_TIMEOUT_ABS_TICKS(1));
  }
}

/**
 * TIM_MICROS_HALTICK MUST be reset by the HAL tick OR be the same tick timer to
 * count microseconds since last tick update. By default ST HAL initializes the
 * tick timer with 1MHz and 1kHz overrun interrupts so TIM_MICROS_HALTICK can be
 * defined as that timer. Alternatively an actual freerunning 32b can be defined
 * as TIM_MICROS to use its count directly. Otherwise the cyclecounter is used.
 */
uint32_t micros() {
  // #ifdef TIM_MICROS_HALTICK
  // 	extern TIM_HandleTypeDef TIM_MICROS_HALTICK;
  // 	return (HAL_GetTick() * 1000) + TIM_MICROS_HALTICK.Instance->CNT;
  // #elif defined(TIM_MICROS)
  // 	extern TIM_HandleTypeDef TIM_MICROS;
  // 	return TIM_MICROS.Instance->CNT;
  // #else
  // 	return DWT->CYCCNT / clkmhz;
  // #endif
  return HAL_GetTick();
}

/**
 * Helper function for RTOS run time measurements
 * Should return a reasonably accurate and large counter value
 */
unsigned long getRunTimeCounterValue(void) { return micros(); }
```

## src/eeprom.cpp
```c
#include "wrapper.h"

#include <cstdio>
#include <zephyr/kernel.h>
#include <zephyr/drivers/flash.h>
#include <zephyr/storage/flash_map.h>
#include <zephyr/device.h>
#include <zephyr/devicetree.h>
#include <zephyr/fs/nvs.h>

#define FFBOARD_PARTITION storage_partition

#define FFBOARD_PARTITION_OFFSET FIXED_PARTITION_OFFSET(FFBOARD_PARTITION)
#define FFBOARD_PARTITION_DEVICE FIXED_PARTITION_DEVICE(FFBOARD_PARTITION)

static struct nvs_fs fs;

uint16_t EE_Init(void)
{
    int rc = 0;
    struct flash_pages_info info;

    fs.flash_device = FFBOARD_PARTITION_DEVICE;
    if (!device_is_ready(fs.flash_device))
    {
        return HAL_ERROR;
    }
    fs.offset = FFBOARD_PARTITION_OFFSET;
    rc = flash_get_page_info_by_offs(fs.flash_device, fs.offset, &info);
    if (rc)
    {
        return HAL_ERROR;
    }
    fs.sector_size = info.size;
    fs.sector_count = 3U;

    rc = nvs_mount(&fs);
    if (rc)
    {
        return HAL_ERROR;
    }

    return HAL_OK;
}

uint16_t EE_ReadVariable(uint16_t VirtAddress, uint16_t *Data)
{
    int rc = nvs_read(&fs, VirtAddress, Data, sizeof(uint16_t));
    return rc > 0 ? HAL_OK : HAL_ERROR;
}

uint16_t EE_WriteVariable(uint16_t VirtAddress, uint16_t Data)
{
    int rc = nvs_write(&fs, VirtAddress, &Data, sizeof(uint16_t));

    return rc > 0 ? HAL_OK : HAL_ERROR;
}

HAL_StatusTypeDef EE_Format(void)
{
    nvs_clear(&fs);
    return HAL_OK;
}
```

## src/main.h
```c
#pragma once

#include "wrapper.h"
```

## src/portable.h
```c
/*
 * FreeRTOS Kernel V10.3.1
 * Copyright (C) 2020 Amazon.com, Inc. or its affiliates.  All Rights Reserved.
 *
 * Permission is hereby granted, free of charge, to any person obtaining a copy of
 * this software and associated documentation files (the "Software"), to deal in
 * the Software without restriction, including without limitation the rights to
 * use, copy, modify, merge, publish, distribute, sublicense, and/or sell copies of
 * the Software, and to permit persons to whom the Software is furnished to do so,
 * subject to the following conditions:
 *
 * The above copyright notice and this permission notice shall be included in all
 * copies or substantial portions of the Software.
 *
 * THE SOFTWARE IS PROVIDED "AS IS", WITHOUT WARRANTY OF ANY KIND, EXPRESS OR
 * IMPLIED, INCLUDING BUT NOT LIMITED TO THE WARRANTIES OF MERCHANTABILITY, FITNESS
 * FOR A PARTICULAR PURPOSE AND NONINFRINGEMENT. IN NO EVENT SHALL THE AUTHORS OR
 * COPYRIGHT HOLDERS BE LIABLE FOR ANY CLAIM, DAMAGES OR OTHER LIABILITY, WHETHER
 * IN AN ACTION OF CONTRACT, TORT OR OTHERWISE, ARISING FROM, OUT OF OR IN
 * CONNECTION WITH THE SOFTWARE OR THE USE OR OTHER DEALINGS IN THE SOFTWARE.
 *
 * http://www.FreeRTOS.org
 * http://aws.amazon.com/freertos
 *
 * 1 tab == 4 spaces!
 */

/*-----------------------------------------------------------
 * Portable layer API.  Each function must be defined for each port.
 *----------------------------------------------------------*/

#ifndef PORTABLE_H
#define PORTABLE_H

/* Each FreeRTOS port has a unique portmacro.h header file.  Originally a
pre-processor definition was used to ensure the pre-processor found the correct
portmacro.h file for the port being used.  That scheme was deprecated in favour
of setting the compiler's include path such that it found the correct
portmacro.h file - removing the need for the constant and allowing the
portmacro.h file to be located anywhere in relation to the port being used.
Purely for reasons of backward compatibility the old method is still valid, but
to make it clear that new projects should not use it, support for the port
specific constants has been moved into the deprecated_definitions.h header
file. */
// #include "deprecated_definitions.h"

/* If portENTER_CRITICAL is not defined then including deprecated_definitions.h
did not result in a portmacro.h header file being included - and it should be
included here.  In this case the path to the correct portmacro.h header file
must be set in the compiler's include path. */
#ifndef portENTER_CRITICAL
	#include "portmacro.h"
#endif

#if portBYTE_ALIGNMENT == 32
	#define portBYTE_ALIGNMENT_MASK ( 0x001f )
#endif

#if portBYTE_ALIGNMENT == 16
	#define portBYTE_ALIGNMENT_MASK ( 0x000f )
#endif

#if portBYTE_ALIGNMENT == 8
	#define portBYTE_ALIGNMENT_MASK ( 0x0007 )
#endif

#if portBYTE_ALIGNMENT == 4
	#define portBYTE_ALIGNMENT_MASK	( 0x0003 )
#endif

#if portBYTE_ALIGNMENT == 2
	#define portBYTE_ALIGNMENT_MASK	( 0x0001 )
#endif

#if portBYTE_ALIGNMENT == 1
	#define portBYTE_ALIGNMENT_MASK	( 0x0000 )
#endif

#ifndef portBYTE_ALIGNMENT_MASK
	#error "Invalid portBYTE_ALIGNMENT definition"
#endif

#ifndef portNUM_CONFIGURABLE_REGIONS
	#define portNUM_CONFIGURABLE_REGIONS 1
#endif

#ifndef portHAS_STACK_OVERFLOW_CHECKING
	#define portHAS_STACK_OVERFLOW_CHECKING 0
#endif

#ifndef portARCH_NAME
	#define portARCH_NAME NULL
#endif

#ifdef __cplusplus
extern "C" {
#endif

// #include "mpu_wrappers.h"

/*
 * Setup the stack of a new task so it is ready to be placed under the
 * scheduler control.  The registers have to be placed on the stack in
 * the order that the port expects to find them.
 *
 */
#if( portUSING_MPU_WRAPPERS == 1 )
	#if( portHAS_STACK_OVERFLOW_CHECKING == 1 )
		StackType_t *pxPortInitialiseStack( StackType_t *pxTopOfStack, StackType_t *pxEndOfStack, TaskFunction_t pxCode, void *pvParameters, BaseType_t xRunPrivileged ) PRIVILEGED_FUNCTION;
	#else
		StackType_t *pxPortInitialiseStack( StackType_t *pxTopOfStack, TaskFunction_t pxCode, void *pvParameters, BaseType_t xRunPrivileged ) PRIVILEGED_FUNCTION;
	#endif
#else
	#if( portHAS_STACK_OVERFLOW_CHECKING == 1 )
		StackType_t *pxPortInitialiseStack( StackType_t *pxTopOfStack, StackType_t *pxEndOfStack, TaskFunction_t pxCode, void *pvParameters ) PRIVILEGED_FUNCTION;
	#else
		StackType_t *pxPortInitialiseStack( StackType_t *pxTopOfStack, TaskFunction_t pxCode, void *pvParameters ) PRIVILEGED_FUNCTION;
	#endif
#endif

/* Used by heap_5.c to define the start address and size of each memory region
that together comprise the total FreeRTOS heap space. */
typedef struct HeapRegion
{
	uint8_t *pucStartAddress;
	size_t xSizeInBytes;
} HeapRegion_t;

/* Used to pass information about the heap out of vPortGetHeapStats(). */
typedef struct xHeapStats
{
	size_t xAvailableHeapSpaceInBytes;		/* The total heap size currently available - this is the sum of all the free blocks, not the largest block that can be allocated. */
	size_t xSizeOfLargestFreeBlockInBytes; 	/* The maximum size, in bytes, of all the free blocks within the heap at the time vPortGetHeapStats() is called. */
	size_t xSizeOfSmallestFreeBlockInBytes; /* The minimum size, in bytes, of all the free blocks within the heap at the time vPortGetHeapStats() is called. */
	size_t xNumberOfFreeBlocks;				/* The number of free memory blocks within the heap at the time vPortGetHeapStats() is called. */
	size_t xMinimumEverFreeBytesRemaining;	/* The minimum amount of total free memory (sum of all free blocks) there has been in the heap since the system booted. */
	size_t xNumberOfSuccessfulAllocations;	/* The number of calls to pvPortMalloc() that have returned a valid memory block. */
	size_t xNumberOfSuccessfulFrees;		/* The number of calls to vPortFree() that has successfully freed a block of memory. */
} HeapStats_t;

/*
 * Used to define multiple heap regions for use by heap_5.c.  This function
 * must be called before any calls to pvPortMalloc() - not creating a task,
 * queue, semaphore, mutex, software timer, event group, etc. will result in
 * pvPortMalloc being called.
 *
 * pxHeapRegions passes in an array of HeapRegion_t structures - each of which
 * defines a region of memory that can be used as the heap.  The array is
 * terminated by a HeapRegions_t structure that has a size of 0.  The region
 * with the lowest start address must appear first in the array.
 */
void vPortDefineHeapRegions( const HeapRegion_t * const pxHeapRegions ) PRIVILEGED_FUNCTION;

/*
 * Returns a HeapStats_t structure filled with information about the current
 * heap state.
 */
void vPortGetHeapStats( HeapStats_t *pxHeapStats );

/*
 * Map to the memory management routines required for the port.
 */
void *pvPortMalloc( size_t xSize ) PRIVILEGED_FUNCTION;
void vPortFree( void *pv ) PRIVILEGED_FUNCTION;
void vPortInitialiseBlocks( void ) PRIVILEGED_FUNCTION;

size_t xPortGetFreeHeapSize( void ) {
	return 100000;
}
size_t xPortGetMinimumEverFreeHeapSize( void ) {
	return 100000;
}

/*
 * Setup the hardware ready for the scheduler to take control.  This generally
 * sets up a tick interrupt and sets timers for the correct tick frequency.
 */
BaseType_t xPortStartScheduler( void ) PRIVILEGED_FUNCTION;

/*
 * Undo any hardware/ISR setup that was performed by xPortStartScheduler() so
 * the hardware is left in its original condition after the scheduler stops
 * executing.
 */
void vPortEndScheduler( void ) PRIVILEGED_FUNCTION;

/*
 * The structures and methods of manipulating the MPU are contained within the
 * port layer.
 *
 * Fills the xMPUSettings structure with the memory region information
 * contained in xRegions.
 */
#if( portUSING_MPU_WRAPPERS == 1 )
	struct xMEMORY_REGION;
	void vPortStoreTaskMPUSettings( xMPU_SETTINGS *xMPUSettings, const struct xMEMORY_REGION * const xRegions, StackType_t *pxBottomOfStack, uint32_t ulStackDepth ) PRIVILEGED_FUNCTION;
#endif

#ifdef __cplusplus
}
#endif

#endif /* PORTABLE_H */
```

## src/portmacro.h
```c
/*
 * FreeRTOS Kernel V10.3.1
 * Copyright (C) 2020 Amazon.com, Inc. or its affiliates.  All Rights Reserved.
 *
 * Permission is hereby granted, free of charge, to any person obtaining a copy of
 * this software and associated documentation files (the "Software"), to deal in
 * the Software without restriction, including without limitation the rights to
 * use, copy, modify, merge, publish, distribute, sublicense, and/or sell copies of
 * the Software, and to permit persons to whom the Software is furnished to do so,
 * subject to the following conditions:
 *
 * The above copyright notice and this permission notice shall be included in all
 * copies or substantial portions of the Software.
 *
 * THE SOFTWARE IS PROVIDED "AS IS", WITHOUT WARRANTY OF ANY KIND, EXPRESS OR
 * IMPLIED, INCLUDING BUT NOT LIMITED TO THE WARRANTIES OF MERCHANTABILITY, FITNESS
 * FOR A PARTICULAR PURPOSE AND NONINFRINGEMENT. IN NO EVENT SHALL THE AUTHORS OR
 * COPYRIGHT HOLDERS BE LIABLE FOR ANY CLAIM, DAMAGES OR OTHER LIABILITY, WHETHER
 * IN AN ACTION OF CONTRACT, TORT OR OTHERWISE, ARISING FROM, OUT OF OR IN
 * CONNECTION WITH THE SOFTWARE OR THE USE OR OTHER DEALINGS IN THE SOFTWARE.
 *
 * http://www.FreeRTOS.org
 * http://aws.amazon.com/freertos
 *
 * 1 tab == 4 spaces!
 */


#ifndef PORTMACRO_H
#define PORTMACRO_H

#ifdef __cplusplus
extern "C" {
#endif

/*-----------------------------------------------------------
 * Port specific definitions.
 *
 * The settings in this file configure FreeRTOS correctly for the
 * given hardware and compiler.
 *
 * These settings should not be altered.
 *-----------------------------------------------------------
 */

/* Type definitions. */
#define portCHAR		char
#define portFLOAT		float
#define portDOUBLE		double
#define portLONG		long
#define portSHORT		short
#define portSTACK_TYPE	uint32_t
#define portBASE_TYPE	long

typedef portSTACK_TYPE StackType_t;
typedef long BaseType_t;
typedef unsigned long UBaseType_t;

#if( configUSE_16_BIT_TICKS == 1 )
	typedef uint16_t TickType_t;
	#define portMAX_DELAY ( TickType_t ) 0xffff
#else
	typedef uint32_t TickType_t;
	#define portMAX_DELAY ( TickType_t ) 0xffffffffUL

	/* 32-bit tick type on a 32-bit architecture, so reads of the tick count do
	not need to be guarded with a critical section. */
	#define portTICK_TYPE_IS_ATOMIC 1
#endif
/*-----------------------------------------------------------*/

/* Architecture specifics. */
#define portSTACK_GROWTH			( -1 )
#define portTICK_PERIOD_MS			( ( TickType_t ) 1000 / configTICK_RATE_HZ )
#define portBYTE_ALIGNMENT			8
/*-----------------------------------------------------------*/

/* Scheduler utilities. */
#if 0
#define portYIELD() 															\
{																				\
	/* Set a PendSV to request a context switch. */								\
	portNVIC_INT_CTRL_REG = portNVIC_PENDSVSET_BIT;								\
																				\
	/* Barriers are normally not required but do ensure the code is completely	\
	within the specified behaviour for the architecture. */						\
	__asm volatile( "dsb" ::: "memory" );										\
	__asm volatile( "isb" );													\
}
#endif
#define portYIELD()

#define portNVIC_INT_CTRL_REG		( * ( ( volatile uint32_t * ) 0xe000ed04 ) )
#define portNVIC_PENDSVSET_BIT		( 1UL << 28UL )
#define portEND_SWITCHING_ISR( xSwitchRequired ) if( xSwitchRequired != pdFALSE ) portYIELD()
#define portYIELD_FROM_ISR( x ) portEND_SWITCHING_ISR( x )
/*-----------------------------------------------------------*/

/* Critical section management. */
extern void vPortEnterCritical( void );
extern void vPortExitCritical( void );
#define portSET_INTERRUPT_MASK_FROM_ISR()		ulPortRaiseBASEPRI()
#define portCLEAR_INTERRUPT_MASK_FROM_ISR(x)	vPortSetBASEPRI(x)
#define portDISABLE_INTERRUPTS()				vPortRaiseBASEPRI()
#define portENABLE_INTERRUPTS()					vPortSetBASEPRI(0)
#define portENTER_CRITICAL()					vPortEnterCritical()
#define portEXIT_CRITICAL()						vPortExitCritical()

/*-----------------------------------------------------------*/

/* Task function macros as described on the FreeRTOS.org WEB site.  These are
not necessary for to use this port.  They are defined so the common demo files
(which build with all the ports) will build. */
#define portTASK_FUNCTION_PROTO( vFunction, pvParameters ) void vFunction( void *pvParameters )
#define portTASK_FUNCTION( vFunction, pvParameters ) void vFunction( void *pvParameters )
/*-----------------------------------------------------------*/

/* Tickless idle/low power functionality. */
#ifndef portSUPPRESS_TICKS_AND_SLEEP
	extern void vPortSuppressTicksAndSleep( TickType_t xExpectedIdleTime );
	#define portSUPPRESS_TICKS_AND_SLEEP( xExpectedIdleTime ) vPortSuppressTicksAndSleep( xExpectedIdleTime )
#endif
/*-----------------------------------------------------------*/

/* Architecture specific optimisations. */
#ifndef configUSE_PORT_OPTIMISED_TASK_SELECTION
	#define configUSE_PORT_OPTIMISED_TASK_SELECTION 1
#endif

#if configUSE_PORT_OPTIMISED_TASK_SELECTION == 1

	/* Generic helper function. */
	__attribute__( ( always_inline ) ) static inline uint8_t ucPortCountLeadingZeros( uint32_t ulBitmap )
	{
	uint8_t ucReturn;

		__asm volatile ( "clz %0, %1" : "=r" ( ucReturn ) : "r" ( ulBitmap ) : "memory" );
		return ucReturn;
	}

	/* Check the configuration. */
	#if( configMAX_PRIORITIES > 32 )
		#error configUSE_PORT_OPTIMISED_TASK_SELECTION can only be set to 1 when configMAX_PRIORITIES is less than or equal to 32.  It is very rare that a system requires more than 10 to 15 difference priorities as tasks that share a priority will time slice.
	#endif

	/* Store/clear the ready priorities in a bit map. */
	#define portRECORD_READY_PRIORITY( uxPriority, uxReadyPriorities ) ( uxReadyPriorities ) |= ( 1UL << ( uxPriority ) )
	#define portRESET_READY_PRIORITY( uxPriority, uxReadyPriorities ) ( uxReadyPriorities ) &= ~( 1UL << ( uxPriority ) )

	/*-----------------------------------------------------------*/

	#define portGET_HIGHEST_PRIORITY( uxTopPriority, uxReadyPriorities ) uxTopPriority = ( 31UL - ( uint32_t ) ucPortCountLeadingZeros( ( uxReadyPriorities ) ) )

#endif /* configUSE_PORT_OPTIMISED_TASK_SELECTION */

/*-----------------------------------------------------------*/

#ifdef configASSERT
	void vPortValidateInterruptPriority( void );
	#define portASSERT_IF_INTERRUPT_PRIORITY_INVALID() 	vPortValidateInterruptPriority()
#endif

/* portNOP() is not required by this port. */
#define portNOP()

#define portINLINE	__inline

#ifndef portFORCE_INLINE
	#define portFORCE_INLINE inline __attribute__(( always_inline))
#endif

portFORCE_INLINE static BaseType_t xPortIsInsideInterrupt( void )
{
uint32_t ulCurrentInterrupt;
BaseType_t xReturn;

	/* Obtain the number of the currently executing interrupt. */
	__asm volatile( "mrs %0, ipsr" : "=r"( ulCurrentInterrupt ) :: "memory" );

	if( ulCurrentInterrupt == 0 )
	{
		xReturn = pdFALSE;
	}
	else
	{
		xReturn = pdTRUE;
	}

	return xReturn;
}

/*-----------------------------------------------------------*/

// portFORCE_INLINE static void vPortRaiseBASEPRI( void )
// {
// uint32_t ulNewBASEPRI;

// 	__asm volatile
// 	(
// 		"	mov %0, %1												\n"	\
// 		"	msr basepri, %0											\n" \
// 		"	isb														\n" \
// 		"	dsb														\n" \
// 		:"=r" (ulNewBASEPRI) : "i" ( configMAX_SYSCALL_INTERRUPT_PRIORITY ) : "memory"
// 	);
// }
portFORCE_INLINE static void vPortRaiseBASEPRI( void ) {

}

/*-----------------------------------------------------------*/

portFORCE_INLINE static uint32_t ulPortRaiseBASEPRI( void )
{
uint32_t ulOriginalBASEPRI, ulNewBASEPRI;

	__asm volatile
	(
		"	mrs %0, basepri											\n" \
		"	mov %1, %2												\n"	\
		"	msr basepri, %1											\n" \
		"	isb														\n" \
		"	dsb														\n" \
		:"=r" (ulOriginalBASEPRI), "=r" (ulNewBASEPRI) : "i" ( configMAX_SYSCALL_INTERRUPT_PRIORITY ) : "memory"
	);

	/* This return will not be reached but is necessary to prevent compiler
	warnings. */
	return ulOriginalBASEPRI;
}
/*-----------------------------------------------------------*/

portFORCE_INLINE static void vPortSetBASEPRI( uint32_t ulNewMaskValue )
{
	__asm volatile
	(
		"	msr basepri, %0	" :: "r" ( ulNewMaskValue ) : "memory"
	);
}
/*-----------------------------------------------------------*/

#define portMEMORY_BARRIER() __asm volatile( "" ::: "memory" )

#ifdef __cplusplus
}
#endif

#endif /* PORTMACRO_H */
```

## src/target_constants.h
```c
/*
 * target_constants.h
 *
 *  Created on: 06.11.2020
 *      Author: Yannick
 */

#ifndef INC_TARGET_CONSTANTS_H_
#define INC_TARGET_CONSTANTS_H_

#include "main.h"

/*
 * Add settings and peripheral maps for this specific target here
 */

// Hardware name string
#define HW_TYPE "NRF52"
#define HW_TYPE_INT 2
#define FW_DEVID 0x413 // F407

// see: https://github.com/zephyrproject-rtos/zephyr/issues/66909
#define M_PI   3.14159265358979323846264338327950288

#ifdef __cplusplus
#endif

// Enabled features
#define DEFAULTMAIN 1 // FFBWheel
// Main classes
#define FFBWHEEL
#define FFBJOYSTICK
#define ESB_CONNECTION
//  #define MIDI
//  #define TMCDEBUG
//  #define CANBRIDGE
//  #define FFBHIDEXT
//  #define RMDCAN

/*
 * FFBWheel uses 2 FFB axis descriptor instead of 1 axis.
 * Might improve compatibility with direct input but will report a 2 axis ffb
 * compatible device
 */
// #define FFBWHEEL_USE_1AXIS_DESC

// Extra features
//  #define LOCALBUTTONS
//  #define SPIBUTTONS
//  #define SHIFTERBUTTONS
//  #define PCF8574BUTTONS // Requires I2C
// #define ANALOGAXES
//  #define TMC4671DRIVER
//  #define PWMDRIVER
//  #define LOCALENCODER
//  #define CANBUS
//  #define ODRIVE
//  #define VESC
//  #define MTENCODERSPI // requires SPI3
//  #define CANBUTTONS // Requires CAN
//  #define CANANALOG // Requires CAN
//  #define BISSENCODER // Requires SPI3
//  #define SSIENCODER // Requires SPI3
//  #define ADS111XANALOG // Requires I2C
//  #define UARTCOMMANDS
//  #define SIMPLEMOTION // Requires motor gpio pin

//----------------------
#define BTNFAILSAFE // Use user button to force board into failsafe mainclass

#define TIM_ENC htim3
// Timer 3 is used by the encoder.
#define TIM_PWM htim1

#define TIM_MICROS_HALTICK                                                     \
  htim7 // Micros timer MUST be reset by hal tick timer or isr to count
        // microseconds since last tick
#define TIM_USER                                                               \
  htim9 // Timer with full core clock speed available for the mainclass
#define TIM_TMC htim6 // Timer running at half clock speed
#define TIM_TMC_BCLK SystemCoreClock / 2

extern UART_HandleTypeDef huart1;
#define UART_PORT_EXT huart1 // main uart port

extern UART_HandleTypeDef huart3;
#define UART_PORT_MOTOR huart3 // motor uart port

#define UART_BUF_SIZE 1 // How many bytes to expect via DMA

// extern I2C_HandleTypeDef hi2c1;
// #define I2C_PORT hi2c1

// ADC Channels
#define ADC1_CHANNELS 8 // how many analog input values to be read by dma
#define ADC2_CHANNELS 2 // VSENSE

extern ADC_HandleTypeDef hadc2;
#define VSENSE_HADC hadc2
#define ADC_CHAN_VINT 1 // adc buffer index of internal voltage sense
#define ADC_CHAN_VEXT 0 // adc buffer index of supply voltage sense
extern volatile uint32_t ADC2_BUF[ADC2_CHANNELS]; // Buffer
#define VSENSE_ADC_BUF ADC2_BUF

extern volatile uint32_t ADC1_BUF[ADC1_CHANNELS]; // Buffer
#define TEMPSENSOR_ADC_VAL ADC1_BUF[6]            // ADC1 ch 7
#define ADC_INTREF_VAL ADC1_BUF[7]                // ADC1 ch 8.

extern ADC_HandleTypeDef hadc1;
#define AIN_HADC hadc1 // main adc for analog pins
#define ADC_PINS 6     // Amount of analog channel pins
#define ADC_CHAN_FPIN                                                          \
  0 // First analog channel pin. last channel = fpin+ADC_PINS-1
// #define VOLTAGE_MULT_DEFAULT 30.12 // mV adc * scaler = voltage

#define BUTTON_PINS 8

extern SPI_HandleTypeDef hspi1;
#define HSPIDRV hspi1
extern SPI_HandleTypeDef hspi2;
#define HSPI2 hspi2
extern SPI_HandleTypeDef hspi3;
#define EXT3_SPI_PORT hspi3

// CAN
#ifdef CANBUS
extern CAN_HandleTypeDef hcan1;
#define CANPORT hcan1
#endif

#define DEBUGPIN // GP1 pin. see cpp target constants

// Flash. 2 pages used
/* EEPROM start address in Flash
 * PAGE_ID sectors 1 and 2!
 * */
#define USE_EEPROM_EMULATION
#define PAGE0_ID FLASH_SECTOR_1
#define PAGE1_ID FLASH_SECTOR_2
#define EEPROM_START_ADDRESS                                                   \
  ((uint32_t)0x08004000) /* EEPROM emulation start address: from sector1*/
#define PAGE_SIZE (uint32_t)0x4000 /* Page size = 16KByte */

// System
// BKPSRAM positions
#define DFU_JUMP_MAGIC_ADR BKPSRAM_BASE + 0

#define CCRAM_SEC ".ccmram"

#endif /* INC_TARGET_CONSTANTS_H_ */
```

## src/wrapper.cpp
```c
#include "wrapper.h"

#include <cstdio>

void Error_Handler()
{
}

size_t xPortGetFreeHeapSize()
{
    return 1024 * 1024;
}

size_t xPortGetMinimumEverFreeHeapSize()
{
    return 1024;
}

uint32_t HAL_RCC_GetHCLKFreq(void)
{
    return 16000000;
}

void RebootDFU()
{
    printf("%s\n", __FUNCTION__);
}

HAL_StatusTypeDef HAL_FLASH_Unlock()
{
    // printf("%s\n", __FUNCTION__);
    return HAL_OK;
}
HAL_StatusTypeDef HAL_FLASH_Lock()
{
    // printf("%s\n", __FUNCTION__);
    return HAL_OK;
}

HAL_StatusTypeDef HAL_FLASHEx_Erase(FLASH_EraseInitTypeDef *pEraseInit, uint32_t *SectorError)
{
    // printf("%s\n", __FUNCTION__);
    return HAL_OK;
}

HAL_StatusTypeDef HAL_FLASH_Program(uint32_t TypeProgram, uint32_t Address, uint64_t Data)
{
    // printf("%s\n", __FUNCTION__);
    return HAL_OK;
}

GPIO_PinState HAL_GPIO_ReadPin(GPIO_TypeDef *GPIOx, uint16_t GPIO_Pin)
{
    // printf("%s\n", __FUNCTION__);
    return GPIO_PIN_RESET;
}

void HAL_GPIO_WritePin(GPIO_TypeDef *GPIOx, uint16_t GPIO_Pin,
                       GPIO_PinState PinState)
{
    // printf("%s\n", __FUNCTION__);
}

void HAL_GPIO_TogglePin(GPIO_TypeDef *GPIOx, uint16_t GPIO_Pin)
{
    // printf("%s\n", __FUNCTION__);
}

HAL_StatusTypeDef HAL_GPIO_LockPin(GPIO_TypeDef *GPIOx, uint16_t GPIO_Pin)
{
    // printf("%s\n", __FUNCTION__);
    return HAL_OK;
}

void HAL_GPIO_EXTI_IRQHandler(uint16_t GPIO_Pin)
{
    // printf("%s\n", __FUNCTION__);
}

uint32_t HAL_GetUIDw0(void)
{
    // printf("%s\n", __FUNCTION__);
    return 123;
}
uint32_t HAL_GetUIDw1(void)
{
    // printf("%s\n", __FUNCTION__);
    return 456;
}
uint32_t HAL_GetUIDw2(void)
{
    // printf("%s\n", __FUNCTION__);
    return 789;
}

void HAL_IncTick(void)
{
    // printf("%s\n", __FUNCTION__);
}

void HAL_Delay(uint32_t Delay)
{
    // printf("%s\n", __FUNCTION__);
}

uint32_t HAL_GetTick(void)
{
    return k_cyc_to_ms_floor32(k_cycle_get_32());
}

uint32_t HAL_GetTickPrio(void)
{
    // printf("%s\n", __FUNCTION__);
    return 0;
}

HAL_StatusTypeDef HAL_SetTickFreq(HAL_TickFreqTypeDef Freq)
{
    // printf("%s\n", __FUNCTION__);
    return HAL_ERROR;
}

HAL_TickFreqTypeDef HAL_GetTickFreq(void)
{
    // printf("%s\n", __FUNCTION__);
    return HAL_TICK_FREQ_1KHZ;
}

void HAL_SuspendTick(void)
{
    // printf("%s\n", __FUNCTION__);
}

void HAL_ResumeTick(void)
{
    // printf("%s\n", __FUNCTION__);
}

uint32_t HAL_GetHalVersion(void)
{
    // printf("%s\n", __FUNCTION__);
    return 0;
}

uint32_t HAL_GetREVID(void)
{
    // printf("%s\n", __FUNCTION__);
    return 0;
}

uint32_t HAL_GetDEVID(void)
{
    // printf("%s\n", __FUNCTION__);
    return 0x413;
}
```

## src/wrapper.h
```c
#pragma once

#ifdef __cplusplus
extern "C" {
#endif

#include <stdint.h>

#include <zephyr/kernel.h>

#define STM32F407xx
#include "stm32f4xx_hal.h"

#include "./freertos_wrappers/common.hpp"

#define DIN7_Pin 0
#define DIN7_GPIO_Port 0
#define DIN6_Pin 0
#define DIN6_GPIO_Port 0
#define DIN5_Pin 0
#define DIN5_GPIO_Port 0
#define DIN4_Pin 0
#define DIN4_GPIO_Port 0
#define DIN3_Pin 0
#define DIN3_GPIO_Port 0
#define DIN2_Pin 0
#define DIN2_GPIO_Port 0
#define DIN1_Pin 0
#define DIN1_GPIO_Port 0
#define DIN0_Pin 0
#define DIN0_GPIO_Port 0

#define AIN2_Pin 0
#define AIN2_GPIO_Port 0
#define AIN1_Pin 0
#define AIN1_GPIO_Port 0
#define AIN0_Pin 0
#define AIN0_GPIO_Port 0

#define SPI1_SCK_Pin 0
#define SPI1_MISO_Pin 0
#define SPI1_MOSI_Pin 0
#define SPI1_SS1_Pin 0
#define SPI1_SS1_GPIO_Port 0
#define SPI1_SS2_Pin 0
#define SPI1_SS2_GPIO_Port 0
#define SPI1_SS3_Pin 0
#define SPI1_SS3_GPIO_Port 0

#define BUTTON_A_Pin 0
#define BUTTON_A_GPIO_Port 0

#define DRV_ENABLE_Pin 0
#define DRV_ENABLE_GPIO_Port 0
#define FLAG_Pin 0
#define FLAG_GPIO_Port 0
#define DRV_GP1_Pin 0
#define DRV_GP1_GPIO_Port 0
#define DRV_BRAKE_Pin 0
#define DRV_BRAKE_GPIO_Port 0

#define PWM1_Pin 0
#define PWM1_GPIO_Port 0
#define PWM2_Pin 0
#define PWM2_GPIO_Port 0
#define PWM3_Pin 0
#define PWM3_GPIO_Port 0
#define PWM4_Pin 0
#define PWM4_GPIO_Port 0

#define ENCODER_Z_Pin 0
#define ENCODER_Z_GPIO_Port 0
#define ENCODER_A_Pin 0
#define ENCODER_A_GPIO_Port 0
#define ENCODER_B_Pin 0
#define ENCODER_B_GPIO_Port 0

#define CAN_RX_Pin 0
#define CAN_TX_Pin 0
#define CAN_S_Pin 0

#define LED_SYS_Pin 0
#define LED_SYS_GPIO_Port 0
#define LED_CLIP_Pin 0
#define LED_CLIP_GPIO_Port 0
#define LED_ERR_Pin 0
#define LED_ERR_GPIO_Port 0

size_t xPortGetFreeHeapSize();
size_t xPortGetMinimumEverFreeHeapSize();

void portYIELD_FROM_ISR(BaseType_t type);

void taskYIELD();

void Error_Handler();

uint16_t EE_Init(void);
uint16_t EE_ReadVariable(uint16_t VirtAddress, uint16_t *Data);
uint16_t EE_WriteVariable(uint16_t VirtAddress, uint16_t Data);
HAL_StatusTypeDef EE_Format();

HAL_StatusTypeDef HAL_FLASH_Unlock();
HAL_StatusTypeDef HAL_FLASH_Lock();

// GPIO_PinState HAL_GPIO_ReadPin(GPIO_TypeDef *GPIOx, uint16_t GPIO_NUM);
// void HAL_GPIO_WritePin(GPIO_TypeDef *GPIOx, uint16_t GPIO_NUM,
//     GPIO_PinState PinState);
// void HAL_GPIO_TogglePin(GPIO_TypeDef *GPIOx, uint16_t GPIO_NUM);
// HAL_StatusTypeDef HAL_GPIO_LockPin(GPIO_TypeDef *GPIOx, uint16_t GPIO_NUM);
// void HAL_GPIO_EXTI_IRQHandler(uint16_t GPIO_NUM);

// void HAL_IncTick(void);
// void HAL_Delay(uint32_t Delay);
// uint32_t HAL_GetTick(void);
// uint32_t HAL_GetTickPrio(void);
// HAL_StatusTypeDef HAL_SetTickFreq(HAL_TickFreqTypeDef Freq);
// HAL_TickFreqTypeDef HAL_GetTickFreq(void);
// void HAL_SuspendTick(void);
// void HAL_ResumeTick(void);
// uint32_t HAL_GetHalVersion(void);
// uint32_t HAL_GetREVID(void);
// uint32_t HAL_GetDEVID(void);
// void HAL_DBGMCU_EnableDBGSleepMode(void);
// void HAL_DBGMCU_DisableDBGSleepMode(void);
// void HAL_DBGMCU_EnableDBGStopMode(void);
// void HAL_DBGMCU_DisableDBGStopMode(void);
// void HAL_DBGMCU_EnableDBGStandbyMode(void);
// void HAL_DBGMCU_DisableDBGStandbyMode(void);
// void HAL_EnableCompensationCell(void);
// void HAL_DisableCompensationCell(void);
// uint32_t HAL_GetUIDw0(void);
// uint32_t HAL_GetUIDw1(void);
// uint32_t HAL_GetUIDw2(void);

uint32_t HAL_RCC_GetHCLKFreq(void);

// // HAL_StatusTypeDef HAL_IWDG_Refresh(IWDG_HandleTypeDef *hiwdg);
// HAL_StatusTypeDef HAL_ADC_Start_DMA(ADC_HandleTypeDef *hadc, uint32_t *pData,
//                                     uint32_t Length);
// HAL_StatusTypeDef HAL_ADC_Stop_DMA(ADC_HandleTypeDef *hadc);

void NVIC_SystemReset();
void RebootDFU();

// HAL_StatusTypeDef HAL_CAN_Start(CAN_HandleTypeDef *hcan);
// HAL_StatusTypeDef HAL_CAN_Stop(CAN_HandleTypeDef *hcan);
// HAL_StatusTypeDef HAL_CAN_ActivateNotification(CAN_HandleTypeDef *hcan,
//                                                uint32_t ActiveITs);
// HAL_StatusTypeDef HAL_CAN_AddTxMessage(CAN_HandleTypeDef *hcan,
//                                        const CAN_TxHeaderTypeDef *pHeader,
//                                        const uint8_t aData[],
//                                        uint32_t *pTxMailbox);
// HAL_StatusTypeDef HAL_CAN_AbortTxRequest(CAN_HandleTypeDef *hcan,
//                                          uint32_t TxMailboxes);
// uint32_t HAL_CAN_GetTxMailboxesFreeLevel(const CAN_HandleTypeDef *hcan);
// uint32_t HAL_CAN_GetTxTimestamp(const CAN_HandleTypeDef *hcan,
//                                 uint32_t TxMailbox);
// HAL_StatusTypeDef HAL_CAN_GetRxMessage(CAN_HandleTypeDef *hcan, uint32_t
// RxFifo,
//                                        CAN_RxHeaderTypeDef *pHeader,
//                                        uint8_t aData[]);
// uint32_t HAL_CAN_GetRxFifoFillLevel(const CAN_HandleTypeDef *hcan,
//                                     uint32_t RxFifo);
// HAL_StatusTypeDef HAL_CAN_ConfigFilter(CAN_HandleTypeDef *hcan,
//                                        const CAN_FilterTypeDef
//                                        *sFilterConfig);
// HAL_StatusTypeDef HAL_CAN_ResetError(CAN_HandleTypeDef *hcan);

#ifdef __cplusplus
}
#endif
```
