## Firmware/Targets/ESP32/sdkconfig.defaults
```kconfig
CONFIG_ESP32S3_DEFAULT_CPU_FREQ_240=y
CONFIG_TINYUSB=y
CONFIG_FREERTOS_HZ=1000
CONFIG_TINYUSB_NO_DEFAULT_TASK=y
CONFIG_TINYUSB_DEBUG_LEVEL=0
CONFIG_TINYUSB_CDC_ENABLED=y
CONFIG_TINYUSB_CDC_COUNT=1
CONFIG_TINYUSB_CDC_RX_BUFSIZE=512
CONFIG_TINYUSB_CDC_TX_BUFSIZE=512
CONFIG_TINYUSB_MIDI_COUNT=1
CONFIG_TINYUSB_HID_COUNT=1
CONFIG_ESP_WIFI_AMPDU_TX_ENABLED=n
CONFIG_ESP_WIFI_AMPDU_RX_ENABLED=n
CONFIG_COMPILER_OPTIMIZATION_PERF=y
```
